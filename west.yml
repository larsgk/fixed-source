## west.yml
```yaml
manifest:
  remotes:
    - name: zephyrproject-rtos
      url-base: https://github.com/zephyrproject-rtos

  projects:
    - name: zephyr
      remote: zephyrproject-rtos
      revision: f970b066d210af56ab6159b2c22e825230c212b9
      import:
        name-allowlist:
          - cmsis
          - hal_nordic
          - tinycrypt
          - libmetal
          - open-amp
```
